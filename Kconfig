## lib/Kconfig
```kconfig
menu "Custom libraries"

rsource "wificonnect/Kconfig"
rsource "turtleweb/Kconfig"
rsource "i2c/Kconfig"
#rsource "pushover/Kconfig"
rsource "webtools/Kconfig"

endmenu
```

## lib/i2c/Kconfig
```kconfig
config I2C_LIB
	bool "Generic i2c lib"
	select I2C
	help
	  This option enables the i2c connect custom library
```

## lib/pushover/Kconfig
```kconfig
config PUSH_OVER
	bool "PushOver Library"
	select NETWORKING
	select WIFI
	select GPIO
	select NET_SHELL
	select CPP
	select NET_IPV4
	select NET_TCP
	select NET_SOCKETS
	select POSIX_API
	select TEST_RANDOM_GENERATOR
	select NET_CONTEXT_NET_PKT_POOL
	select NET_CONFIG_SETTINGS
	select HTTP_CLIENT
	select WEB_TOOLS
	#select MBEDTLS
	#select MBEDTLS_ENABLE_HEAP
	#select MBEDTLS_KEY_EXCHANGE_ECDHE_RSA_ENABLED
	#select MBEDTLS_ECP_DP_SECP256R1_ENABLED
	#select MBEDTLS_ECDH_C
	#select MBEDTLS_ECP_C
	#select NET_SOCKETS_SOCKOPT_TLS
	help
	  This option enables the PushOver custom library
```

## lib/turtleweb/Kconfig
```kconfig
config TURTLE_WEB
	bool "Turtle web server"
	select HTTP_PARSER_URL
    select HTTP_PARSER
    select HTTP_SERVER
    select HTTP_SERVER_WEBSOCKET
	select EVENTFD
	help
	  This option enables the turtle web custom library

config HEAP_MEM_POOL_ADD_SIZE_TURTLE_WEB
	int
	default 4096 if TURTLE_WEB
	default 0
	help
	  Make sure there is a minimal heap available for turtle web driver.

if TURTLE_WEB
config NET_SAMPLE_HTTP_SERVICE
	bool "Enable http service"
	default y

config NET_SAMPLE_HTTP_SERVER_SERVICE_PORT
	int "Port number for http service"
	default 80
	depends on NET_SAMPLE_HTTP_SERVICE

config NET_SAMPLE_HTTPS_SERVICE
	bool "Enable https service"
	depends on NET_SOCKETS_SOCKOPT_TLS || TLS_CREDENTIALS
	imply MBEDTLS_PSA_CRYPTO_C if !BUILD_WITH_TFM

if NET_SAMPLE_HTTPS_SERVICE

config NET_SAMPLE_HTTPS_SERVER_SERVICE_PORT
	int "Port number for https service"
	default 443
	depends on NET_SAMPLE_HTTPS_SERVICE

config NET_SAMPLE_HTTPS_USE_ALPN
	bool "Allow HTTP2 connectivity with web browsers by using ALPN"
	select MBEDTLS_SSL_ALPN
	select HTTP_SERVER_TLS_USE_ALPN
	help
	  Web browsers only use HTTP/2 over HTTPS, and use ALPN to determine if a
	  server supports HTTP/2. If this option is enabled, web browsers can use
	  HTTP/2 to communicate with the server. However web browsers are stricter
	  with security when using HTTP/2, at a minimum you will need to add the CA
	  certificate used to sign the server certificate into your web browser's
	  trusted authorities. Otherwise the connection can fail with a security
	  error, without giving an option to ignore this and proceed anyway.

endif # NET_SAMPLE_HTTPS_SERVICE

config NET_SAMPLE_PSK_HEADER_FILE
	string "Header file containing PSK"
	default "dummy_psk.h"
	depends on MBEDTLS_KEY_EXCHANGE_PSK_ENABLED
	help
	  Name of a header file containing a
	  pre-shared key.

config NET_SAMPLE_WEBSOCKET_SERVICE
	bool "Enable websocket service"
	default y if HTTP_SERVER_WEBSOCKET

config NET_SAMPLE_NUM_WEBSOCKET_HANDLERS
	int "How many websocket connections to serve at the same time"
	depends on NET_SAMPLE_WEBSOCKET_SERVICE
	default 1
	help
	  Each websocket connection is served by a thread which needs
	  memory. Only increase the value here if really needed.

config NET_SAMPLE_WEBSOCKET_STATS_INTERVAL
	int "Interval in milliseconds to send network stats over websocket"
	depends on NET_SAMPLE_WEBSOCKET_SERVICE
	default 200
	help
	  This interval controls how often the net stats data shown on the web page
	  will be updated.
endif # TURTLE_WEB
```

## lib/webtools/Kconfig
```kconfig
config WEB_TOOLS
	bool "Web custom library"
	select NETWORKING
	select WIFI
	select GPIO
	select NET_SHELL
	select NET_L2_WIFI_SHELL
	select CPP
	select NET_DHCPV4
	select NET_IPV4
	select NET_TCP
	help
	  This option enables the Web custom library
```

## lib/wificonnect/Kconfig
```kconfig
config WIFI_CONNECT
	bool "Wifi connect custom library"
	select NETWORKING
	select WIFI
	select GPIO
	select NET_SHELL
	select NET_L2_WIFI_SHELL
	select CPP
	select NET_DHCPV4
	select NET_IPV4
	select NET_TCP
	help
	  This option enables the Wifi connect custom library
```
